## boards/enclustra/mercury_xu_apu/Kconfig
```kconfig
# Copyright (c) 2025 Stefan Jaritz
# SPDX-License-Identifier: Apache-2.0

config UART_XLNX_PS
	select PINCTRL if BOARD_MERCURY_XU_APU
```

## boards/enclustra/mercury_xu_apu/Kconfig.mercury_xu_apu
```kconfig
# Copyright (c) 2025, Stefan Jaritz
# SPDX-License-Identifier: Apache-2.0

config BOARD_MERCURY_XU_APU
	select SOC_AMD_ZYNQMP_APU
```

## boards/enclustra/mercury_xu_apu/board.yml
```yaml
board:
  name: mercury_xu_apu
  full_name: MERCURY-XU-APU
  vendor: enclustra
  socs:
  - name: zynqmp_apu
```

## boards/enclustra/mercury_xu_apu/mercury_xu_apu_defconfig
```kconfig
# Copyright (c) 2025, Stefan Jaritz

# Enable UART driver
CONFIG_SERIAL=y

# Enable console
CONFIG_CONSOLE=y
CONFIG_UART_CONSOLE=y

# Enable timer
CONFIG_SYS_CLOCK_TICKS_PER_SEC=100
```

## soc/amd/zynqmp_apu/Kconfig
```kconfig
# Copyright (c) 2025, Stefan Jaritz
# SPDX-License-Identifier: Apache-2.0

config SOC_AMD_ZYNQMP_APU
	select ARM64
	select CPU_CORTEX_A53
	# select ARM_ARCH_TIMER if SYS_CLOCK_EXISTS
	# select SOC_PREP_HOOK
```

## soc/amd/zynqmp_apu/Kconfig.defconfig
```kconfig
# Copyright (c) 2025, Stefan Jaritz
# SPDX-License-Identifier: Apache-2.0

if SOC_AMD_ZYNQMP

if SOC_AMD_ZYNQMP_APU

config NUM_IRQS
	default 220

config SYS_CLOCK_HW_CYCLES_PER_SEC
	default 5000000

config ARM64_PA_BITS
	default 40
	
config SMP
	default y

config SCHED_CPU_MASK
	default y

endif # SOC_AMD_ZYNQMP_APU

# Workaround for not being able to have commas in macro arguments
DT_CHOSEN_Z_FLASH := zephyr,flash

config FLASH_SIZE
	default $(dt_chosen_reg_size_int,$(DT_CHOSEN_Z_FLASH),0,K)

config FLASH_BASE_ADDRESS
	default $(dt_chosen_reg_addr_hex,$(DT_CHOSEN_Z_FLASH))

endif # SOC_AMD_ZYNQMP
```

## soc/amd/zynqmp_apu/Kconfig.soc
```kconfig
# Copyright (c) 2025, Stefan Jaritz
# SPDX-License-Identifier: Apache-2.0

config SOC_AMD_ZYNQMP
	bool
	select SOC_FAMILY_ARM64

config SOC_AMD_ZYNQMP_APU
	bool
	select SOC_AMD_ZYNQMP
	help
	  AMD Zynq UltraScale+ MPSoC APU config

config SOC_FAMILY
	default "amd_zynqmp" if SOC_AMD_ZYNQMP

config SOC
	default "zynqmp_apu" if SOC_AMD_ZYNQMP_APU
```
